/ {
	amba_pl: amba_pl {
		ranges;
		compatible = "simple-bus";
		#address-cells = <1>;
		#size-cells = <1>;
		firmware-name = "qaoa_wrapper.bit.bin";
		clocking0: clocking0 {
			compatible = "xlnx,fclk";
			assigned-clocks = <&clkc 15>;
			assigned-clock-rates = <100000000>;
			#clock-cells = <0>;
			clock-output-names = "fabric_clk";
			clocks = <&clkc 15>;
		};
		qaoa_kernel_0: qaoa_kernel@40000000 {
			compatible = "xlnx,qaoa-kernel-1.0";
			xlnx,ii = "159885 , ~ , 206110";
			xlnx,machine = <64>;
			xlnx,s-axi-control-addr-width = <7>;
			xlnx,rable = <0>;
			xlnx,ip-name = "qaoa_kernel";
			reg = <0x40000000 0x10000>;
			clocks = <&clkc 15>;
			xlnx,clk-period = <10>;
			xlnx,s-axi-control-data-width = <32>;
			xlnx,edk-iptype = "PERIPHERAL";
			status = "okay";
			clock-names = "ap_clk";
			xlnx,combinational = <0>;
			xlnx,latency = <159885>;
			xlnx,name = "qaoa_kernel_0";
		};
	};
};
